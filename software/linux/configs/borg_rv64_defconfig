## software/linux/overlay/drivers/gpu/drm/borg/Kconfig
```kconfig
# SPDX-License-Identifier: GPL-2.0 or MIT

config DRM_BORG
	tristate "Borg (Rust DRM driver for the Borg GPU and its display)"
	depends on DRM=y
	depends on RUST
	select DRM_KMS_HELPER
	select DRM_GEM_DMA_HELPER
	select DRM_CLIENT_SELECTION
	default n
	help
	  The Borg GPU: register writes and word access to the GPU memory, which
	  Mesa's borgvk drives, and its HDMI scan-out as a KMS display.
```
